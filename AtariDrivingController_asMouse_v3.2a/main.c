/* "Atari Driving Controller" seen as a mouse to USB (interrupt version)
 * Copyright (C) 2021 Francis-Olivier Gradel, B.Eng.
 *
 * Using V-USB code from OBJECTIVE DEVELOPMENT Software GmbH. http://www.obdev.at/products/vusb/
 *
 * This program is free software; you can redistribute it and/or modify
 * it under the terms of the GNU General Public License as published by
 * the Free Software Foundation; either version 2 of the License, or
 * (at your option) any later version.
 *
 * This program is distributed in the hope that it will be useful,
 * but WITHOUT ANY WARRANTY; without even the implied warranty of
 * MERCHANTABILITY or FITNESS FOR A PARTICULAR PURPOSE.  See the
 * GNU General Public License for more details.
 *
 * You should have received a copy of the GNU General Public License along
 * with this program; if not, write to the Free Software Foundation, Inc.,
 * 51 Franklin Street, Fifth Floor, Boston, MA 02110-1301 USA.
 *
 * The author may be contacted at info@retronicdesign.com
 */

#include <avr/io.h>
#include <avr/wdt.h>
#include <avr/interrupt.h>  /* for sei() */
#include <util/delay.h>     /* for _delay_ms() */
#include <avr/pgmspace.h>   /* required by usbdrv.h */
#include "usbdrv.h"

#include "../bootloader/fuses.h"
#include "../bootloader/bootloader.h"

#define MULT	8

unsigned char jumptobootloader;

static void AtariInit(void);
static void UpdateReportBuffer(void);

static unsigned char mouse;
static unsigned char old_mouse;
static char mouse_dx;
static int quad_x;

char QEM [16] = {0,1,-1,2,-1,0,2,1,1,2,0,-1,2,-1,1,0};               // Quadrature Encoder Matrix
/* QEM explanation:
 *
 * Quadrature from an Atari Driving controller is made of two 90 degree out of phase signals that corresponds to
 * two perforated wheels driven by the knob. The perforated wheels are hiding or showing IR LED
 * to IR detectors on the other side that generate these signals. 
 *
 * Here is an example of a signal of the controller going left:
 *           ________            ________            ________            ____
 *          /        \          /        \          /        \          /
 * XB  ____/          \________/          \________/          \________/
 *              ________            ________            ________
 *             /        \          /        \          /        \
 * XA ________/          \________/          \________/          \__________
 *
 * Here is an example of a signal of the controller going right:
 *
 *           ________            ________            ________            ____
 *          /        \          /        \          /        \          /
 * XB  ____/          \________/          \________/          \________/
 * 
 * XA ________            ________            ________            ________
 *            \          /        \          /        \          /
 *             \________/          \________/          \________/
 *
 * Note on these two example the difference in phase between XB and XA for up and down.
 *
 * Using these generated waves, we can determine by software the delta displacement of the mouse.
 * The following table is generated by combining these signals in two 2-bit value, XB, XA, XB' and XA'.
 *
 *        Actual read value (XB-XA 2-bit combination)
 *        0   1   2   3
 *     ----------------
 *   0 |  0   1  -1   X
 *   
 *   1 | -1   0   X   1
 *
 *   2 |  1   X   0  -1
 *  
 *   3 |  X  -1   1   0
 *
 *   Previous read value (XB-XA 2-bit combination)
 *
 */

/* ------------------------------------------------------------------------- */
/* ----------------------------- USB interface ----------------------------- */
/* ------------------------------------------------------------------------- */

PROGMEM const char usbHidReportDescriptor[66] = { /* USB report descriptor, size must match usbconfig.h */
    0x05, 0x01,                    // USAGE_PAGE (Generic Desktop)
    0x09, 0x02,                    // USAGE (Mouse)
    0xa1, 0x01,                    // COLLECTION (Application)
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    0xC0,                          // END COLLECTION
};
/* This is the same report descriptor as seen in a Logitech mouse. The data
 * described by this descriptor consists of 4 bytes:
 *      .  .  .  .  . B2 B1 B0 .... one byte with mouse button states
 *     X7 X6 X5 X4 X3 X2 X1 X0 .... 8 bit signed relative coordinate x
 *     Y7 Y6 Y5 Y4 Y3 Y2 Y1 Y0 .... 8 bit signed relative coordinate y
 *     W7 W6 W5 W4 W3 W2 W1 W0 .... 8 bit signed relative coordinate wheel
 */
typedef struct{
    uchar   buttonMask;
    char    dx;
    char    dy;
    char    dWheel;
}report_t;

static report_t reportBuffer;
static uchar    idleRate;   /* repeat rate for keyboards, never used for mice */

/* ------------------------------------------------------------------------- */

usbMsgLen_t usbFunctionSetup(uchar data[8])
{
usbRequest_t    *rq = (void *)data;

    /* The following requests are never used. But since they are required by
     * the specification, we implement them in this example.
     */
    if((rq->bmRequestType & USBRQ_TYPE_MASK) == USBRQ_TYPE_CLASS){    /* class request type */
        if(rq->bRequest == USBRQ_HID_GET_REPORT){  /* wValue: ReportType (highbyte), ReportID (lowbyte) */
            /* we only have one report type, so don't look at wValue */
            usbMsgPtr = (usbMsgPtr_t)&reportBuffer;
            return sizeof(reportBuffer);
		}else if(rq->bRequest == USBRQ_HID_SET_REPORT){
			return USB_NO_MSG;  /* use usbFunctionWrite() to receive data from host */
        }else if(rq->bRequest == USBRQ_HID_GET_IDLE){
            usbMsgPtr = (usbMsgPtr_t)&idleRate;
            return 1;
        }else if(rq->bRequest == USBRQ_HID_SET_IDLE){
            idleRate = rq->wValue.bytes[1];
        }
    }
	
    return 0;   /* default for not implemented requests: return no data back to host */
}

uchar   usbFunctionWrite(uchar *data, uchar len)
{
	if(data[0]==0x5A)
		jumptobootloader=1;
	return len;
}

/* ------------------------------------------------------------------------- */

__attribute__ ((OS_main)) int main(void)
{
    wdt_enable(WDTO_2S);
    /* Even if you don't use the watchdog, turn it off here. On newer devices,
     * the status of the watchdog (on/off, period) is PRESERVED OVER RESET!
     */
    /* RESET status: all port bits are inputs without pull-up.
     * That's the way we need D+ and D-. Therefore we don't need any
     * additional hardware initialization.
     */
	jumptobootloader=0;
	AtariInit();
    usbInit();
    usbDeviceDisconnect();  /* enforce re-enumeration, do this while interrupts are disabled! */
	_delay_ms(10);	// 10ms is enough to see the USB disconnection and reconnection
    usbDeviceConnect();
    sei();
    for(;;){                /* main event loop */
        wdt_reset();
		if(jumptobootloader)
		{
			cli(); // Clear interrupts
			/* magic boot key in memory to invoke reflashing 0x013B-0x013C = BEEF */
			unsigned int *BootKey=(unsigned int*)0x013b;
			*BootKey=0xBEEF;

			/* USB disconnect */
			DDRD |= ((1<<PD0)|(1<<PD2));
			for(;;); // Let wdt reset the CPU
		}
        usbPoll();
        if(usbInterruptIsReady()){
            /* called after every poll of the interrupt endpoint */
		   UpdateReportBuffer();
            usbSetInterrupt((void *)&reportBuffer, sizeof(reportBuffer));
        }
    }
}

/* ------------------------------------------------------------------------- */

static void AtariInit(void)
{

#define MOUSE_XB	PB0
#define MOUSE_XA 	PB1
#define MOUSE_BUT1	PB4

	/* PIN1 = PB0   = XB
	 * PIN2 = PB1   = XA
	 * PIN3 = PB2   = nc
	 * PIN4 = PB3   = nc
	 * PIN5 = PC1&3 = nc
	 * PIN6 = PB4   = BUT1
	 * PIN7 = PB5   = VCC
	 * PIN8 = PB7   = GND
	 * PIN9 = PC0&2 = nc
	 */
	
	DDRB &= ~((1<<PB0)|(1<<PB1)|(1<<PB4));
	PORTB |= ((1<<PB0)|(1<<PB1)|(1<<PB4));

	DDRB |= (1<<PB5);
	PORTB |= (1<<PB5);

	DDRD |= (1<<PD7);
	PORTD &= ~(1<<PD7);
	
	PCICR |= (1<<PCIE0); // Enable interrupts on PCINT0:7 (PB0-PB7)
	PCMSK0 |= ((1<<PCINT0)|(1<<PCINT1)|(1<<PCINT4)); // Enable interrupts on PBO, PB1 and PB4

	mouse_dx = 0;	// Not moving
	
	old_mouse = mouse = ~PINB;	// Initial read
}

ISR(PCINT0_vect) // Trigged whenever a bit change on mouse reading
{
	mouse = ~PINB;	// Read port

	// Apply delta displacement from quadrature generated by the mouse, in x and y.
	// Quad Format (4 bits): MSB OldXB OldXA ActualXB ActualXA LSB
	quad_x=((mouse&(1<<MOUSE_XA))?1:0)|((mouse&(1<<MOUSE_XB))?2:0)|((old_mouse&(1<<MOUSE_XA))?4:0)|((old_mouse&(1<<MOUSE_XB))?8:0);
	mouse_dx += QEM[quad_x];

	old_mouse = mouse;	// Keep previous value of the port for quadrature calculation.
}

static void UpdateReportBuffer(void)
{
	// Send up to date delta displacements that happened during the USB polling interval.
	reportBuffer.dx = mouse_dx * MULT;
	mouse_dx=0;

	reportBuffer.dy = 0;

	// Button Format (3 bits): MSB BUT1 LSB
	reportBuffer.buttonMask = ((mouse&(1<<MOUSE_BUT1))>>4);	// Update Button status
}
